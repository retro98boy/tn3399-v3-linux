/dts-v1/;

#include "rk3399-tn3399-v3-with-lvds-panel.dtsi"

/ {
	vcc_panel: vcc-panel {
		regulator-min-microvolt = <3300000>;
		regulator-max-microvolt = <3300000>;
		vin-supply = <&vcc3v3_sys>;
	};
};

&mipi_dsi {
	panel@0 {
		compatible = "tc358775,1024x600-single-8bit";
	};
};

